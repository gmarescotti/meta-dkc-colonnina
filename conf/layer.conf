## conf/layer.conf
```bitbake
# We have a conf and classes directory, add to BBPATH
BBPATH .= ":${LAYERDIR}"

# We have recipes-* directories, add to BBFILES
BBFILES += "${LAYERDIR}/recipes-*/*/*.bb \
            ${LAYERDIR}/recipes-*/*/*.bbappend"

BBFILE_COLLECTIONS += "meta-dkc-colonnina"
BBFILE_PATTERN_meta-dkc-colonnina = "^${LAYERDIR}/"
BBFILE_PRIORITY_meta-dkc-colonnina = "6"

LAYERDEPENDS_meta-dkc-colonnina = "core"
LAYERSERIES_COMPAT_meta-dkc-colonnina = "dunfell"
```
